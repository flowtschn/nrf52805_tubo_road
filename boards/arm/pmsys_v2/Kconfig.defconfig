## boards/arm/pmsys_v2/Kconfig.defconfig
```kconfig
# Copyright (c) 2024 Nordic Semiconductor ASA
# SPDX-License-Identifier: Apache-2.0

if BOARD_PMSYS_V2

config BOARD
	default "pmsys_v2"

config BT_CTLR
   default BT


endif
```

## boards/arm/pmsys_v3/Kconfig.defconfig
```kconfig
# Copyright (c) 2024 Nordic Semiconductor ASA
# SPDX-License-Identifier: Apache-2.0

if BOARD_PMSYS_V3

config BOARD
	default "pmsys_v3"

config BT_CTLR
   default BT


endif
```

## boards/arm/pmsys_v5/Kconfig.board
```kconfig
# Copyright (c) 2024 Nordic Semiconductor ASA
# SPDX-License-Identifier: Apache-2.0

config BOARD_PMSYS_V5
	bool "pmsys_v5"
	depends on SOC_NRF52805_CAAA
```

## boards/arm/pmsys_v5/Kconfig.defconfig
```kconfig
# Copyright (c) 2024 Nordic Semiconductor ASA
# SPDX-License-Identifier: Apache-2.0

if BOARD_PMSYS_V5

config BOARD
	default "pmsys_v5"

config BT_CTLR
   default BT


endif
```
